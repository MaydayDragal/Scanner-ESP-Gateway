## sdkconfig.defaults
```kconfig
CONFIG_IDF_TARGET="esp32s3"
CONFIG_ESPTOOLPY_FLASHSIZE_16MB=y
CONFIG_ESP_CONSOLE_USB_SERIAL_JTAG=y
CONFIG_ESP_CONSOLE_SECONDARY_NONE=y
CONFIG_TINYUSB_MSC_ENABLED=y
CONFIG_TINYUSB_NET_MODE_NONE=y
# CONFIG_TINYUSB_NET_MODE_NCM is not set
CONFIG_LWIP_TCP_WND_DEFAULT=32768
CONFIG_LWIP_TCP_SND_BUF_DEFAULT=32768
CONFIG_LWIP_TCP_RECVMBOX_SIZE=24
CONFIG_LWIP_MAX_SOCKETS=16
CONFIG_ESP_MAIN_TASK_STACK_SIZE=6144
CONFIG_FATFS_FS_LOCK=16
CONFIG_TINYUSB_DESC_PRODUCT_STRING="Scanner USB Storage"
CONFIG_TINYUSB_DESC_CUSTOM_PID=0x4002
CONFIG_TINYUSB_DESC_USE_ESPRESSIF_VID=y

# CONFIG_TINYUSB_DESC_USE_DEFAULT_PID is not set
```
